/* USER CODE BEGIN Header */
/**
  ******************************************************************************
  * @file           : main.c
  * @brief          : Main program body
  ******************************************************************************
  * @attention
  *
  * Copyright (c) 2024 STMicroelectronics.
  * All rights reserved.
  *
  * This software is licensed under terms that can be found in the LICENSE file
  * in the root directory of this software component.
  * If no LICENSE file comes with this software, it is provided AS-IS.
  *
  ******************************************************************************
  */
/* USER CODE END Header */
/* Includes ------------------------------------------------------------------*/
#include "main.h"
#include "cmsis_os.h"

/* Private includes ----------------------------------------------------------*/
/* USER CODE BEGIN Includes */
#include "stm32f4xx_hal.h"
#include <string.h>
#include <stdarg.h>
#include <stdio.h>
#include <stdbool.h>
#include <stdlib.h>
#include "ili9341.h"
#include "ili9341_touch.h"
#include "fonts.h"
#include "testimg.h"
#include "sht2x_for_stm32_hal.h"
/* USER CODE END Includes */

/* Private typedef -----------------------------------------------------------*/
/* USER CODE BEGIN PTD */

/* USER CODE END PTD */

/* Private define ------------------------------------------------------------*/
/* USER CODE BEGIN PD */
#define INCREMENT 1
#define PADDLE_WIDTH 5
#define PADDLE_HEIGHT 30
#define PADDLE_SPEED 4
#define BALL_SIZE 3
#define BALL_VELY 5
#define BALL_VELX 5
/* USER CODE END PD */

/* Private macro -------------------------------------------------------------*/
/* USER CODE BEGIN PM */

/* USER CODE END PM */

/* Private variables ---------------------------------------------------------*/
I2C_HandleTypeDef hi2c1;

RTC_HandleTypeDef hrtc;

SPI_HandleTypeDef hspi1;
DMA_HandleTypeDef hdma_spi1_tx;

osThreadId defaultTaskHandle;
osThreadId baca_shtHandle;
osThreadId displayHandle;
osThreadId input_pollHandle;
osThreadId game_masterHandle;
osSemaphoreId disp_semaphoreHandle;
/* USER CODE BEGIN PV */
static float temp=0;
static float hum;
char str1[40];
char str2[40];
char date[150];
char score_left[10];
char score_right[10];
int scoreL;
int scoreR;
float buffer[10]; // Moving Average Filter
float buffer_hum[10];
float filtered_temp;
float filtered_hum;
int x,y;
int oldx,oldy;
int ouserx,ousery;
int obotx,oboty;
int random_number;
//bool isDrawing;
bool playerEnable;

typedef struct {
	int x;
	int y;
	int width;
	int height;
	int speed;
} paddle;

typedef struct {
	int x;
	int y;
	int velx;
	int vely;
	int rad;
} ball;

paddle user;
paddle bot;
ball bola;

// GAMBAR PETIR
const uint16_t test_img_50x50[][50] = {
{0x0000,0x0000,0x0000,0x0000,0x0000,0x0000,0x0000,0x0000,0x0000,0x0000,0x0000,0x0000,0x0000,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0x0000,},
{0x0000,0x0000,0x0000,0x0000,0x0000,0x0000,0x0000,0x0000,0x0000,0x0000,0x0000,0x0000,0x0000,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0x0000,},
{0x0000,0x0000,0x0000,0x0000,0x0000,0x0000,0x0000,0x0000,0x0000,0x0000,0x0000,0x0000,0x0000,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0x0000,},
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{0x0000,0x0000,0x0000,0x0000,0x0000,0x0000,0x0000,0x0000,0x0000,0x0000,0x0000,0x0000,0x0000,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0xA210,},
};

// Gambar SOST
const uint16_t gambar_sost[][50] = {
{0x0000,0x0000,0x0000,0x0000,0x0000,0x0000,0x0000,0x0000,0x0000,0x0000,0x0000,0x0000,0x0000,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0x0000,},
{0x0000,0x0000,0x0000,0x0000,0x0000,0x0000,0x0000,0x0000,0x0000,0x0000,0x6108,0xA631,0xAE73,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0x0000,},
{0x0000,0x0000,0x0000,0x0000,0x0000,0x0000,0x0000,0x0000,0x0000,0x6108,0xCF7B,0x1CE7,0xDFFF,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0x0000,},
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{0x0000,0x0000,0x0000,0x0000,0x0000,0x0000,0x0000,0x0000,0x0000,0x0000,0x0000,0x0000,0x0000,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0xA210,},
};

// Plus Cursor
const uint16_t cursor[][5] = {
{0x0000,0x0000,0xFFFF,0x0000,0x0000,},
{0x0000,0x0000,0xFFFF,0x0000,0x0000,},
{0xFFFF,0xFFFF,0xFFFF,0xFFFF,0xFFFF,},
{0x0000,0x0000,0xFFFF,0x0000,0x0000,},
{0x0000,0x0000,0xFFFF,0x0000,0x0000,},
};

/* USER CODE END PV */

/* Private function prototypes -----------------------------------------------*/
void SystemClock_Config(void);
static void MX_GPIO_Init(void);
static void MX_DMA_Init(void);
static void MX_SPI1_Init(void);
static void MX_I2C1_Init(void);
static void MX_RTC_Init(void);
void StartDefaultTask(void const * argument);
void start_baca_sht(void const * argument);
void start_display(void const * argument);
void start_input_poll(void const * argument);
void start_game_master(void const * argument);

/* USER CODE BEGIN PFP */
void display_init() {
    ILI9341_Unselect();
    ILI9341_TouchUnselect();
    ILI9341_Init();
}

void init_cursor(uint16_t x, uint16_t y){
	ILI9341_DrawImage(x,y,5,5,(const uint16_t*)cursor);
}

void drawCursor (uint16_t x, uint16_t y, uint16_t x_old, uint16_t y_old){
	ILI9341_FillRectangle(x_old,y_old,5,5,ILI9341_BLACK);
	init_cursor(x,y);
}

void initPong(){
	user.x = 250;
	user.y = 170;
	user.width = PADDLE_WIDTH;
	user.height = PADDLE_HEIGHT;
	user.speed = PADDLE_SPEED;
	bot.x = 70-PADDLE_WIDTH;
	bot.y = 170;
	bot.width = PADDLE_WIDTH;
	bot.height = PADDLE_HEIGHT;
	bot.speed = PADDLE_SPEED;
	bola.x=160;
	bola.y=170;
	bola.velx=BALL_VELX;
	bola.vely=BALL_VELY;
	bola.rad=BALL_SIZE;
	// init paddle dan bola di display
	ILI9341_FillRectangle(user.x,user.y,PADDLE_WIDTH,PADDLE_HEIGHT,ILI9341_WHITE);
	ILI9341_FillRectangle(bot.x,bot.y,PADDLE_WIDTH,PADDLE_HEIGHT,ILI9341_WHITE);

	ILI9341_FillRectangle(bola.x-bola.rad/2,bola.y-bola.rad/2,bola.rad,bola.rad,ILI9341_WHITE);
}

void updateBallPos(uint16_t x, uint16_t y, uint16_t x_old, uint16_t y_old){
	ILI9341_FillRectangle(x_old-bola.rad/2,y_old-bola.rad/2,bola.rad,bola.rad,ILI9341_BLACK);
	ILI9341_FillRectangle(x-bola.rad/2,y-bola.rad/2,bola.rad,bola.rad,ILI9341_WHITE);
}

void updatePaddlePos(uint16_t x, uint16_t y, uint16_t x_old, uint16_t y_old){
	//ILI9341_FillRectangle(x_old-(PADDLE_WIDTH/2),y_old-(PADDLE_HEIGHT/2),PADDLE_WIDTH,PADDLE_HEIGHT,ILI9341_BLACK);
	//ILI9341_FillRectangle(x-(PADDLE_WIDTH/2),y-(PADDLE_HEIGHT/2),PADDLE_WIDTH,PADDLE_HEIGHT,ILI9341_WHITE);
	ILI9341_FillRectangle(x_old,y_old,PADDLE_WIDTH,PADDLE_HEIGHT,ILI9341_BLACK);
	ILI9341_FillRectangle(x,y,PADDLE_WIDTH,PADDLE_HEIGHT,ILI9341_WHITE);
}

void resetBallStatus(){
	ILI9341_FillRectangle(bola.x-bola.rad/2,bola.y-bola.rad/2,bola.rad,bola.rad,ILI9341_BLACK);
	int rand_vx;
	int rand_vy;
	bola.x=160;
	bola.y=170;
	random_number = rand();
	srand(random_number);
	rand_vx = random_number % 2;
	random_number = rand();
	rand_vy = random_number % 2;
	if(rand_vx==1)
	{
		bola.velx=BALL_VELX;
	}
	else
	{
		bola.velx=-BALL_VELX;
	}

	if(rand_vy==1)
	{
		bola.vely=BALL_VELY;
	}
	else
	{
		bola.vely=-BALL_VELY;
	}
	bola.rad=BALL_SIZE;
}
/* USER CODE END PFP */

/* Private user code ---------------------------------------------------------*/
/* USER CODE BEGIN 0 */

/* USER CODE END 0 */

/**
  * @brief  The application entry point.
  * @retval int
  */
int main(void)
{
  /* USER CODE BEGIN 1 */

  /* USER CODE END 1 */

  /* MCU Configuration--------------------------------------------------------*/

  /* Reset of all peripherals, Initializes the Flash interface and the Systick. */
  HAL_Init();

  /* USER CODE BEGIN Init */

  /* USER CODE END Init */

  /* Configure the system clock */
  SystemClock_Config();

  /* USER CODE BEGIN SysInit */

  /* USER CODE END SysInit */

  /* Initialize all configured peripherals */
  MX_GPIO_Init();
  MX_DMA_Init();
  MX_SPI1_Init();
  MX_I2C1_Init();
  MX_RTC_Init();
  /* USER CODE BEGIN 2 */
  display_init();
  SHT2x_Init(&hi2c1);
  SHT2x_SetResolution(RES_14_12);
  ILI9341_FillScreen(ILI9341_BLACK);

  // INIT AREA UNTUK NAMA
  ILI9341_FillRectangle(0,0,ILI9341_HEIGHT,40,ILI9341_WHITE);
  ILI9341_FillRectangle(5,5,ILI9341_HEIGHT-10,30,ILI9341_BLACK);
  ILI9341_WriteString(10, 10, "BINTANG DAN RAKKA - TEAM 5", Font_11x18, 0xf800, ILI9341_BLACK);

  // AREA UNTUK MENGGAMBAR ATAU PONG ???
  ILI9341_FillRectangle(0,100,ILI9341_HEIGHT,140,ILI9341_WHITE);
  ILI9341_FillRectangle(5,105,ILI9341_HEIGHT-10,130,ILI9341_BLACK);

  // (x,y,width,height,color)
  // scoreboard kiri
  ILI9341_FillRectangle(0,100,60,40,ILI9341_WHITE);
  ILI9341_FillRectangle(5,105,50,30,ILI9341_BLACK);

  // scoreboard kanan
  ILI9341_FillRectangle(260,100,60,40,ILI9341_WHITE);
  ILI9341_FillRectangle(265,105,50,30,ILI9341_BLACK);

  // gambar petir
  ILI9341_DrawImage(260,45,50,50,(const uint16_t*)test_img_50x50);

  // init cursor awal di x = 160 dan y = 170
  x=160;
  y=170;
  oldx=x;
  oldy=y;

  //init_cursor(x,y);

  // init paddle dan bola

  initPong();

  ouserx=user.x;
  ousery=user.y;
  obotx=bot.x;
  oboty=bot.y;

  // init score
  scoreL=0;
  scoreR=0;

  /* USER CODE END 2 */

  /* USER CODE BEGIN RTOS_MUTEX */
  /* add mutexes, ... */
  /* USER CODE END RTOS_MUTEX */

  /* Create the semaphores(s) */
  /* definition and creation of disp_semaphore */
  osSemaphoreDef(disp_semaphore);
  disp_semaphoreHandle = osSemaphoreCreate(osSemaphore(disp_semaphore), 1);

  /* USER CODE BEGIN RTOS_SEMAPHORES */
  /* add semaphores, ... */
  /* USER CODE END RTOS_SEMAPHORES */

  /* USER CODE BEGIN RTOS_TIMERS */
  /* start timers, add new ones, ... */
  /* USER CODE END RTOS_TIMERS */

  /* USER CODE BEGIN RTOS_QUEUES */
  /* add queues, ... */
  /* USER CODE END RTOS_QUEUES */

  /* Create the thread(s) */
  /* definition and creation of defaultTask */
  osThreadDef(defaultTask, StartDefaultTask, osPriorityNormal, 0, 128);
  defaultTaskHandle = osThreadCreate(osThread(defaultTask), NULL);

  /* definition and creation of baca_sht */
  osThreadDef(baca_sht, start_baca_sht, osPriorityLow, 0, 512);
  baca_shtHandle = osThreadCreate(osThread(baca_sht), NULL);

  /* definition and creation of display */
  osThreadDef(display, start_display, osPriorityAboveNormal, 0, 1024);
  displayHandle = osThreadCreate(osThread(display), NULL);

  /* definition and creation of input_poll */
  osThreadDef(input_poll, start_input_poll, osPriorityNormal, 0, 256);
  input_pollHandle = osThreadCreate(osThread(input_poll), NULL);

  /* definition and creation of game_master */
  osThreadDef(game_master, start_game_master, osPriorityBelowNormal, 0, 1024);
  game_masterHandle = osThreadCreate(osThread(game_master), NULL);

  /* USER CODE BEGIN RTOS_THREADS */
  /* add threads, ... */
  /* USER CODE END RTOS_THREADS */

  /* Start scheduler */
  osKernelStart();

  /* We should never get here as control is now taken by the scheduler */
  /* Infinite loop */
  /* USER CODE BEGIN WHILE */
  while (1)
  {
    /* USER CODE END WHILE */

    /* USER CODE BEGIN 3 */
  }
  /* USER CODE END 3 */
}

/**
  * @brief System Clock Configuration
  * @retval None
  */
void SystemClock_Config(void)
{
  RCC_OscInitTypeDef RCC_OscInitStruct = {0};
  RCC_ClkInitTypeDef RCC_ClkInitStruct = {0};

  /** Configure the main internal regulator output voltage
  */
  __HAL_RCC_PWR_CLK_ENABLE();
  __HAL_PWR_VOLTAGESCALING_CONFIG(PWR_REGULATOR_VOLTAGE_SCALE1);

  /** Initializes the RCC Oscillators according to the specified parameters
  * in the RCC_OscInitTypeDef structure.
  */
  RCC_OscInitStruct.OscillatorType = RCC_OSCILLATORTYPE_HSI|RCC_OSCILLATORTYPE_LSI;
  RCC_OscInitStruct.HSIState = RCC_HSI_ON;
  RCC_OscInitStruct.HSICalibrationValue = RCC_HSICALIBRATION_DEFAULT;
  RCC_OscInitStruct.LSIState = RCC_LSI_ON;
  RCC_OscInitStruct.PLL.PLLState = RCC_PLL_ON;
  RCC_OscInitStruct.PLL.PLLSource = RCC_PLLSOURCE_HSI;
  RCC_OscInitStruct.PLL.PLLM = 8;
  RCC_OscInitStruct.PLL.PLLN = 100;
  RCC_OscInitStruct.PLL.PLLP = RCC_PLLP_DIV2;
  RCC_OscInitStruct.PLL.PLLQ = 4;
  if (HAL_RCC_OscConfig(&RCC_OscInitStruct) != HAL_OK)
  {
    Error_Handler();
  }

  /** Initializes the CPU, AHB and APB buses clocks
  */
  RCC_ClkInitStruct.ClockType = RCC_CLOCKTYPE_HCLK|RCC_CLOCKTYPE_SYSCLK
                              |RCC_CLOCKTYPE_PCLK1|RCC_CLOCKTYPE_PCLK2;
  RCC_ClkInitStruct.SYSCLKSource = RCC_SYSCLKSOURCE_PLLCLK;
  RCC_ClkInitStruct.AHBCLKDivider = RCC_SYSCLK_DIV1;
  RCC_ClkInitStruct.APB1CLKDivider = RCC_HCLK_DIV2;
  RCC_ClkInitStruct.APB2CLKDivider = RCC_HCLK_DIV1;

  if (HAL_RCC_ClockConfig(&RCC_ClkInitStruct, FLASH_LATENCY_3) != HAL_OK)
  {
    Error_Handler();
  }
}

/**
  * @brief I2C1 Initialization Function
  * @param None
  * @retval None
  */
static void MX_I2C1_Init(void)
{

  /* USER CODE BEGIN I2C1_Init 0 */

  /* USER CODE END I2C1_Init 0 */

  /* USER CODE BEGIN I2C1_Init 1 */

  /* USER CODE END I2C1_Init 1 */
  hi2c1.Instance = I2C1;
  hi2c1.Init.ClockSpeed = 100000;
  hi2c1.Init.DutyCycle = I2C_DUTYCYCLE_2;
  hi2c1.Init.OwnAddress1 = 0;
  hi2c1.Init.AddressingMode = I2C_ADDRESSINGMODE_7BIT;
  hi2c1.Init.DualAddressMode = I2C_DUALADDRESS_DISABLE;
  hi2c1.Init.OwnAddress2 = 0;
  hi2c1.Init.GeneralCallMode = I2C_GENERALCALL_DISABLE;
  hi2c1.Init.NoStretchMode = I2C_NOSTRETCH_DISABLE;
  if (HAL_I2C_Init(&hi2c1) != HAL_OK)
  {
    Error_Handler();
  }
  /* USER CODE BEGIN I2C1_Init 2 */

  /* USER CODE END I2C1_Init 2 */

}

/**
  * @brief RTC Initialization Function
  * @param None
  * @retval None
  */
static void MX_RTC_Init(void)
{

  /* USER CODE BEGIN RTC_Init 0 */

  /* USER CODE END RTC_Init 0 */

  RTC_TimeTypeDef sTime = {0};
  RTC_DateTypeDef sDate = {0};

  /* USER CODE BEGIN RTC_Init 1 */

  /* USER CODE END RTC_Init 1 */

  /** Initialize RTC Only
  */
  hrtc.Instance = RTC;
  hrtc.Init.HourFormat = RTC_HOURFORMAT_24;
  hrtc.Init.AsynchPrediv = 127;
  hrtc.Init.SynchPrediv = 255;
  hrtc.Init.OutPut = RTC_OUTPUT_DISABLE;
  hrtc.Init.OutPutPolarity = RTC_OUTPUT_POLARITY_HIGH;
  hrtc.Init.OutPutType = RTC_OUTPUT_TYPE_OPENDRAIN;
  if (HAL_RTC_Init(&hrtc) != HAL_OK)
  {
    Error_Handler();
  }

  /* USER CODE BEGIN Check_RTC_BKUP */

  /* USER CODE END Check_RTC_BKUP */

  /** Initialize RTC and set the Time and Date
  */
  sTime.Hours = 0x0;
  sTime.Minutes = 0x0;
  sTime.Seconds = 0x0;
  sTime.DayLightSaving = RTC_DAYLIGHTSAVING_NONE;
  sTime.StoreOperation = RTC_STOREOPERATION_RESET;
  if (HAL_RTC_SetTime(&hrtc, &sTime, RTC_FORMAT_BCD) != HAL_OK)
  {
    Error_Handler();
  }
  sDate.WeekDay = RTC_WEEKDAY_SUNDAY;
  sDate.Month = RTC_MONTH_SEPTEMBER;
  sDate.Date = 0x22;
  sDate.Year = 0x24;

  if (HAL_RTC_SetDate(&hrtc, &sDate, RTC_FORMAT_BCD) != HAL_OK)
  {
    Error_Handler();
  }
  /* USER CODE BEGIN RTC_Init 2 */

  /* USER CODE END RTC_Init 2 */

}

/**
  * @brief SPI1 Initialization Function
  * @param None
  * @retval None
  */
static void MX_SPI1_Init(void)
{

  /* USER CODE BEGIN SPI1_Init 0 */

  /* USER CODE END SPI1_Init 0 */

  /* USER CODE BEGIN SPI1_Init 1 */

  /* USER CODE END SPI1_Init 1 */
  /* SPI1 parameter configuration*/
  hspi1.Instance = SPI1;
  hspi1.Init.Mode = SPI_MODE_MASTER;
  hspi1.Init.Direction = SPI_DIRECTION_2LINES;
  hspi1.Init.DataSize = SPI_DATASIZE_8BIT;
  hspi1.Init.CLKPolarity = SPI_POLARITY_LOW;
  hspi1.Init.CLKPhase = SPI_PHASE_1EDGE;
  hspi1.Init.NSS = SPI_NSS_SOFT;
  hspi1.Init.BaudRatePrescaler = SPI_BAUDRATEPRESCALER_4;
  hspi1.Init.FirstBit = SPI_FIRSTBIT_MSB;
  hspi1.Init.TIMode = SPI_TIMODE_DISABLE;
  hspi1.Init.CRCCalculation = SPI_CRCCALCULATION_DISABLE;
  hspi1.Init.CRCPolynomial = 10;
  if (HAL_SPI_Init(&hspi1) != HAL_OK)
  {
    Error_Handler();
  }
  /* USER CODE BEGIN SPI1_Init 2 */

  /* USER CODE END SPI1_Init 2 */

}

/**
  * Enable DMA controller clock
  */
static void MX_DMA_Init(void)
{

  /* DMA controller clock enable */
  __HAL_RCC_DMA2_CLK_ENABLE();

  /* DMA interrupt init */
  /* DMA2_Stream2_IRQn interrupt configuration */
  HAL_NVIC_SetPriority(DMA2_Stream2_IRQn, 5, 0);
  HAL_NVIC_EnableIRQ(DMA2_Stream2_IRQn);

}

/**
  * @brief GPIO Initialization Function
  * @param None
  * @retval None
  */
static void MX_GPIO_Init(void)
{
  GPIO_InitTypeDef GPIO_InitStruct = {0};
/* USER CODE BEGIN MX_GPIO_Init_1 */
/* USER CODE END MX_GPIO_Init_1 */

  /* GPIO Ports Clock Enable */
  __HAL_RCC_GPIOC_CLK_ENABLE();
  __HAL_RCC_GPIOH_CLK_ENABLE();
  __HAL_RCC_GPIOA_CLK_ENABLE();
  __HAL_RCC_GPIOB_CLK_ENABLE();

  /*Configure GPIO pin Output Level */
  HAL_GPIO_WritePin(GPIOC, GPIO_PIN_13, GPIO_PIN_RESET);

  /*Configure GPIO pin Output Level */
  HAL_GPIO_WritePin(GPIOB, GPIO_PIN_0|GPIO_PIN_1|GPIO_PIN_10, GPIO_PIN_RESET);

  /*Configure GPIO pin : PC13 */
  GPIO_InitStruct.Pin = GPIO_PIN_13;
  GPIO_InitStruct.Mode = GPIO_MODE_OUTPUT_PP;
  GPIO_InitStruct.Pull = GPIO_NOPULL;
  GPIO_InitStruct.Speed = GPIO_SPEED_FREQ_LOW;
  HAL_GPIO_Init(GPIOC, &GPIO_InitStruct);

  /*Configure GPIO pins : PB0 PB1 PB10 */
  GPIO_InitStruct.Pin = GPIO_PIN_0|GPIO_PIN_1|GPIO_PIN_10;
  GPIO_InitStruct.Mode = GPIO_MODE_OUTPUT_PP;
  GPIO_InitStruct.Pull = GPIO_NOPULL;
  GPIO_InitStruct.Speed = GPIO_SPEED_FREQ_LOW;
  HAL_GPIO_Init(GPIOB, &GPIO_InitStruct);

  /*Configure GPIO pins : up_Pin down_Pin right_Pin left_Pin
                           draw_stop_Pin */
  GPIO_InitStruct.Pin = up_Pin|down_Pin|right_Pin|left_Pin
                          |draw_stop_Pin;
  GPIO_InitStruct.Mode = GPIO_MODE_INPUT;
  GPIO_InitStruct.Pull = GPIO_PULLDOWN;
  HAL_GPIO_Init(GPIOA, &GPIO_InitStruct);

/* USER CODE BEGIN MX_GPIO_Init_2 */
/* USER CODE END MX_GPIO_Init_2 */
}

/* USER CODE BEGIN 4 */

/* USER CODE END 4 */

/* USER CODE BEGIN Header_StartDefaultTask */
/**
  * @brief  Function implementing the defaultTask thread.
  * @param  argument: Not used
  * @retval None
  */
/* USER CODE END Header_StartDefaultTask */
void StartDefaultTask(void const * argument)
{
  /* USER CODE BEGIN 5 */
  /* Infinite loop */
  for(;;)
  {
	HAL_GPIO_TogglePin(GPIOC, GPIO_PIN_13);
	osDelay(500);
  }
  /* USER CODE END 5 */
}

/* USER CODE BEGIN Header_start_baca_sht */
/**
* @brief Function implementing the baca_sht thread.
* @param argument: Not used
* @retval None
*/
/* USER CODE END Header_start_baca_sht */
void start_baca_sht(void const * argument)
{
  /* USER CODE BEGIN start_baca_sht */
  /* Infinite loop */
  for(;;)
  {
	temp = SHT2x_GetTemperature(1);
	hum = SHT2x_GetRelativeHumidity(1);
	float sum_temp=0;
	float sum_hum=0;
	// Filter Section for Temp & Hum
	for(int i=0;i<9;i++)
	{
		buffer[i]=buffer[i+1];
		sum_temp=sum_temp+buffer[i];
	}
	buffer[9]=temp;
	sum_temp=sum_temp+buffer[9];
	filtered_temp=sum_temp/10.0;

	for(int i=0;i<9;i++)
	{
		buffer_hum[i]=buffer_hum[i+1];
		sum_hum=sum_hum+buffer_hum[i];
	}
	buffer_hum[9]=hum;
	sum_hum=sum_hum+buffer_hum[9];
	filtered_hum=sum_hum/10.0;
	// End of Filter Section

	snprintf(str1, sizeof(str1), "Temperature = %.2f C", filtered_temp);
	snprintf(str2, sizeof(str2), "R. Humidity = %.2f %%", hum);
    osDelay(500);
  }
  /* USER CODE END start_baca_sht */
}

/* USER CODE BEGIN Header_start_display */
/**
* @brief Function implementing the display thread.
* @param argument: Not used
* @retval None
*/
/* USER CODE END Header_start_display */
void start_display(void const * argument)
{
  /* USER CODE BEGIN start_display */
  /* Infinite loop */
  for(;;)
  {

	RTC_DateTypeDef currentDate;
	RTC_TimeTypeDef currentTime;

	HAL_RTC_GetTime(&hrtc, &currentTime, RTC_FORMAT_BIN);
	HAL_RTC_GetDate(&hrtc, &currentDate, RTC_FORMAT_BIN);
	snprintf(date, sizeof(date), "Uptime: %02d:%02d:%02d", currentTime.Hours, currentTime.Minutes, currentTime.Seconds);
	srand(currentTime.Seconds);
	ILI9341_WriteString(0, 50, str1, Font_11x18, 0x663f, ILI9341_BLACK);
	//ILI9341_WriteString(0, 70, str2, Font_11x18, 0x04bf, ILI9341_BLACK); // show humidity
	ILI9341_WriteString(0, 70, date, Font_11x18, ILI9341_WHITE, ILI9341_BLACK); // show time
	ILI9341_WriteString(10, 110, score_left, Font_11x18, 0xff80, ILI9341_BLACK); // show time
	ILI9341_WriteString(270, 110, score_right, Font_11x18, 0x07e2, ILI9341_BLACK); // show time
	/*
	if(isDrawing==true)
	{
		ILI9341_FillRectangle(x,y,3,3,ILI9341_WHITE);
	}
	else
		drawCursor(x,y,oldx,oldy);*/
	updateBallPos(bola.x,bola.y,oldx,oldy);
	updatePaddlePos(user.x,user.y,ouserx,ousery);
	updatePaddlePos(bot.x,bot.y,obotx,oboty);
    osDelay(16);
  }
  /* USER CODE END start_display */
}

/* USER CODE BEGIN Header_start_input_poll */
/**
* @brief Function implementing the input_poll thread.
* @param argument: Not used
* @retval None
*/
/* USER CODE END Header_start_input_poll */
void start_input_poll(void const * argument)
{
  /* USER CODE BEGIN start_input_poll */
  /* Infinite loop */
  for(;;)
  {
	  /* sistem untuk gambar
	// arah atas
	if(HAL_GPIO_ReadPin(GPIOA, GPIO_PIN_10) && y-INCREMENT>=108)
	{
		oldy = y;
		y=y-INCREMENT;
	}
	// arah bawah
	else if(HAL_GPIO_ReadPin(GPIOA, GPIO_PIN_9) && y+INCREMENT<=232)
	{
		oldy = y;
		y=y+INCREMENT;
	}
	// kiri
	else if(HAL_GPIO_ReadPin(GPIOA, GPIO_PIN_8) && x-INCREMENT>=8)
	{
		oldx = x;
		x=x-INCREMENT;
	}
	// kanan
	else if(HAL_GPIO_ReadPin(GPIOA, GPIO_PIN_11) && x+INCREMENT<=312)
	{
		oldx = x;
		x=x+INCREMENT;
	}

	if(HAL_GPIO_ReadPin(GPIOA, GPIO_PIN_12) && isDrawing==false)
		isDrawing=true;
	else if(HAL_GPIO_ReadPin(GPIOA, GPIO_PIN_12) && isDrawing==true)
		isDrawing=false;
		*/

	 if(HAL_GPIO_ReadPin(GPIOA, GPIO_PIN_12) && playerEnable==false)
	  	playerEnable=true;
	 else if(HAL_GPIO_ReadPin(GPIOA, GPIO_PIN_12) && playerEnable==true)
	  	playerEnable=false;
	 // paddle user ke atas
	 if(HAL_GPIO_ReadPin(GPIOA, GPIO_PIN_11) && user.y>=110)
	 {
	  	ousery = user.y;
	  	user.y=user.y-user.speed;
	 }
	 // paddle bot ke bawah
	 else if(HAL_GPIO_ReadPin(GPIOA, GPIO_PIN_10) && user.y+user.height<=230)
	 {
		ousery = user.y;
		user.y=user.y+user.speed;
	 }
	 if(HAL_GPIO_ReadPin(GPIOA, GPIO_PIN_9) && bot.y>=110 && playerEnable==true)
	 {
	 	oboty = bot.y;
	 	bot.y=bot.y-bot.speed;
	 }
	 	 // paddle bot ke bawah
	 else if(HAL_GPIO_ReadPin(GPIOA, GPIO_PIN_8) && bot.y+bot.height<=230 && playerEnable==true)
	 {
	 	oboty = bot.y;
	    bot.y=bot.y+bot.speed;
	 }
    osDelay(16);
  }
  /* USER CODE END start_input_poll */
}

/* USER CODE BEGIN Header_start_game_master */
/**
* @brief Function implementing the game_master thread.
* @param argument: Not used
* @retval None
*/
/* USER CODE END Header_start_game_master */
void start_game_master(void const * argument)
{
  /* USER CODE BEGIN start_game_master */
  /* Infinite loop */
  for(;;)
  {
	// Crossing Paddle Score
	if(bola.x+2>=user.x+user.width && (bola.y >= user.y+user.height || bola.y <= user.y)){
	  	scoreL=scoreL+1;
	  	snprintf(score_left, sizeof(score_left), "%d", scoreL);
	  	resetBallStatus();
	}
	else if(bola.x<=bot.x && (bola.y >= bot.y+bot.height || bola.y <= bot.y)){
	  	scoreR=scoreR+1;
	  	snprintf(score_right, sizeof(score_right), "%d", scoreR);
	  	resetBallStatus();
	}

	// Reflecting Algorithm
	if(bola.x+2>=user.x && (bola.y >= user.y && bola.y <= user.y+user.height)){
		bola.velx=-bola.velx;
	}
	else if(bola.x<=bot.x+bot.width && (bola.y >= bot.y && bola.y <= bot.y+bot.height)){
		bola.velx=-bola.velx;
	}

	// Reflecting With Top and Bottom Boundary
	if(bola.y<=110){
		bola.vely=-bola.vely;
	}
	else if(bola.y>=229){
		bola.vely=-bola.vely;
	}

	// bot (left paddle) chasing ball's y position
	if((bot.y+bot.height/2 != bola.y+1 && playerEnable == false)/* && (bot.y>=120 || bot.y+bot.height<=240)*/)
	{
		if((bot.y+bot.height/2 < bola.y+1) && bot.y+bot.height<=230)
		{
			oboty=bot.y;
			bot.y=bot.y+bot.speed;
		}
		else if((bot.y+bot.height/2 > bola.y+1) && bot.y>=110)
		{	oboty=bot.y;
			bot.y=bot.y-bot.speed;
		}
	}

	oldx=bola.x;
	oldy=bola.y;
	bola.x=bola.x+bola.velx;
	bola.y=bola.y+bola.vely;
    osDelay(16);
  }
  /* USER CODE END start_game_master */
}

/**
  * @brief  Period elapsed callback in non blocking mode
  * @note   This function is called  when TIM1 interrupt took place, inside
  * HAL_TIM_IRQHandler(). It makes a direct call to HAL_IncTick() to increment
  * a global variable "uwTick" used as application time base.
  * @param  htim : TIM handle
  * @retval None
  */
void HAL_TIM_PeriodElapsedCallback(TIM_HandleTypeDef *htim)
{
  /* USER CODE BEGIN Callback 0 */

  /* USER CODE END Callback 0 */
  if (htim->Instance == TIM1) {
    HAL_IncTick();
  }
  /* USER CODE BEGIN Callback 1 */

  /* USER CODE END Callback 1 */
}

/**
  * @brief  This function is executed in case of error occurrence.
  * @retval None
  */
void Error_Handler(void)
{
  /* USER CODE BEGIN Error_Handler_Debug */
  /* User can add his own implementation to report the HAL error return state */
  __disable_irq();
  while (1)
  {
  }
  /* USER CODE END Error_Handler_Debug */
}

#ifdef  USE_FULL_ASSERT
/**
  * @brief  Reports the name of the source file and the source line number
  *         where the assert_param error has occurred.
  * @param  file: pointer to the source file name
  * @param  line: assert_param error line source number
  * @retval None
  */
void assert_failed(uint8_t *file, uint32_t line)
{
  /* USER CODE BEGIN 6 */
  /* User can add his own implementation to report the file name and line number,
     ex: printf("Wrong parameters value: file %s on line %d\r\n", file, line) */
  /* USER CODE END 6 */
}
#endif /* USE_FULL_ASSERT */
